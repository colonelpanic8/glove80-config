## host-lighting/Kconfig
```kconfig
menuconfig ZMK_HOST_LIGHTING
    bool "Ephemeral host-controlled key lighting"
    depends on ZMK_RGB_UNDERGLOW
    help
      Allow a connected host to temporarily override individual key LEDs.
      Host frames are never persisted and expire back to normal underglow.

if ZMK_HOST_LIGHTING

config ZMK_HOST_LIGHTING_RPC
    bool "ZMK Studio RPC interface"
    default y
    depends on ZMK_STUDIO_RPC && ZMK_SPLIT_ROLE_CENTRAL

config ZMK_HOST_LIGHTING_MAX_UPDATES
    int "Maximum pixel updates in one request"
    default 8
    range 1 16

config ZMK_HOST_LIGHTING_MAX_UPDATE_HZ
    int "Advertised maximum update rate"
    default 20
    range 1 40

config ZMK_HOST_LIGHTING_TIMEOUT_DEFAULT_MS
    int "Default host frame timeout"
    default 5000
    range 250 30000

config ZMK_HOST_LIGHTING_TIMEOUT_MAX_MS
    int "Maximum host frame timeout"
    default 30000
    range 1000 60000

config ZMK_HOST_LIGHTING_MAX_CHANNEL
    int "Maximum RGB channel value"
    default 96
    range 1 255

config ZMK_HOST_LIGHTING_EFFECT_PERIOD_MIN_MS
    int "Minimum per-key effect period"
    default 200
    range 100 2000

config ZMK_HOST_LIGHTING_EFFECT_PERIOD_MAX_MS
    int "Maximum per-key effect period"
    default 10000
    range 2000 12000

config ZMK_HOST_LIGHTING_EFFECT_TIME_QUANTUM_MS
    int "Per-key effect timing quantum"
    default 50
    range 25 100
    help
      Periods and phase offsets are rounded to this resolution so two effect
      descriptions fit in one default BLE ATT payload.

config ZMK_HOST_LIGHTING_STATUS_PIXEL
    int "Firmware status LED index (-1 disables)"
    default 2 if ZMK_SPLIT_ROLE_CENTRAL
    default -1
    range -1 255
    help
      Reserve one central-half key LED as a firmware status indicator. Glove80
      LED index 2 is the left Magic/MoErgo key.

endif
```
